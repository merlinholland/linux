## arch/arm/mach-bsp/Kconfig
```kconfig
config ARCH_BSP
	bool "Vendor SoC Support"
	select ARM_AMBA
	select ARM_GIC if ARCH_MULTI_V7 && !ARCH_SS318V100 && !ARCH_SS918V100 && !ARCH_SS013V100
	select ARM_VIC if ARCH_MULTI_V5
	select ARM_TIMER_SP804
	select POWER_RESET
	select POWER_SUPPLY

if ARCH_BSP

menu "Vendor platform type"

config ARCH_SS524V100
	bool "SS524V100 Cortex-A7 family"
	depends on ARCH_MULTI_V7
	select HAVE_ARM_ARCH_TIMER
	select PINCTRL
	select POWER_RESET_BSP
	help
		Support for SS524V100 Soc family.

config ARCH_SS615V100
	bool "SS615V100 Cortex-A7 family"
	depends on ARCH_MULTI_V7
	select HAVE_ARM_ARCH_TIMER
	select PINCTRL
	select POWER_RESET_BSP
	help
		Support for SS615V100 Soc family.

config ARCH_SS522V100
	bool "SS522V100 Cortex-A7 family"
	depends on ARCH_MULTI_V7
	select HAVE_ARM_ARCH_TIMER
	select PINCTRL
	select POWER_RESET_BSP
	help
		Support for SS522V100 Soc family.

config ARCH_SS522V101
	bool "SS522V101 Cortex-A7 family"
	depends on ARCH_MULTI_V7
	select HAVE_ARM_ARCH_TIMER
	select PINCTRL
	select POWER_RESET_BSP
	help
		Support for SS522V101 Soc family.
config ARCH_SS812V100
	bool "SS812V100 Cortex-A7 family"
	depends on ARCH_MULTI_V7
	select HAVE_ARM_ARCH_TIMER
	select PINCTRL
    select POWER_RESET_BSP
	help
		Support for SS812V100 Soc family.

config ARCH_SS813V100
	bool "SS813V100 Cortex-A7 family"
	depends on ARCH_MULTI_V7
	select HAVE_ARM_ARCH_TIMER
	select PINCTRL
    select POWER_RESET_BSP
	help
		Support for SS813V100 Soc family.

config ARCH_SS101V200
	bool "SS101V200 Cortex-A7 family"
	depends on ARCH_MULTI_V7
	select HAVE_ARM_ARCH_TIMER
	select PINCTRL
    select POWER_RESET_BSP
	help
		Support for SS101V200 Soc family.

config ARCH_SS101V500
	bool "SS101V500 Cortex-A7 family"
	depends on ARCH_MULTI_V7
	select HAVE_ARM_ARCH_TIMER
	select PINCTRL
    select POWER_RESET_BSP
	help
		Support for SS101V500 Soc family.

config ARCH_SS101V300
	bool "SS101V300 Cortex-A7 family"
	depends on ARCH_MULTI_V7
	select HAVE_ARM_ARCH_TIMER
	select PINCTRL
    select POWER_RESET_BSP
	help
		Support for SS101V300 Soc family.

config ARCH_SS101V600
	bool "SS101V600 Cortex-A7 family"
	depends on ARCH_MULTI_V7
	select HAVE_ARM_ARCH_TIMER
	select PINCTRL
    select POWER_RESET_BSP
	help
		Support for SS101V600 Soc family.
config ARCH_SS312V100
	bool "SS312V100 Cortex-A7 family"
	depends on ARCH_MULTI_V7
	select HAVE_ARM_ARCH_TIMER
	select PINCTRL
    select POWER_RESET_BSP
	help
		Support for SS312V100 Soc family.

config ARCH_SS313V100
	bool "SS313V100 Cortex-A7 family"
	depends on ARCH_MULTI_V7
	select HAVE_ARM_ARCH_TIMER
	select PINCTRL
    select POWER_RESET_BSP
	help
		Support for SS313V100 Soc family.

config ARCH_SS612V100
	bool "SS612V100 Cortex-A7(Single) family"
	depends on ARCH_MULTI_V7
	select HAVE_ARM_ARCH_TIMER
	select PINCTRL
	help
		Support for SS612V100 Soc family.

config ARCH_SS318V100
	bool "SS318V100 Cortex-a53 family" if ARCH_MULTI_V7
	select HAVE_ARM_ARCH_TIMER
	select ARCH_HAS_RESET_CONTROLLER
	select RESET_CONTROLLER
	select PMC if SMP
	select ARM_GIC_V3
	help
	  Support for SS318V100 Soc family
if ARCH_SS318V100

config PMC
	bool
	depends on ARCH_SS318V100
	help
	  support power control for SS318V100 Cortex-a53

endif

config ARCH_SS918V100
	bool "SS918V100 Cortex-a53 family" if ARCH_MULTI_V7
	select HAVE_ARM_ARCH_TIMER
	select ARCH_HAS_RESET_CONTROLLER
	select RESET_CONTROLLER
	select NEED_MACH_IO_H if PCI
	select PMC if SMP
	select ARM_GIC_V3
	help
	  Support for SS918V100 Soc family
if ARCH_SS918V100

config PMC
	bool
	depends on ARCH_SS918V100
	help
	  support power control for SS918V100 Cortex-a53

endif

config ARCH_SS013V100
	bool "SS013V100 Cortex-a53 family" if ARCH_MULTI_V7
	select HAVE_ARM_ARCH_TIMER
	select ARCH_HAS_RESET_CONTROLLER
	select RESET_CONTROLLER
	select NEED_MACH_IO_H if PCI
	select PMC if SMP
	select ARM_GIC_V3
	help
	  Support for SS013V100 Soc family
if ARCH_SS013V100

config PMC
	bool
	depends on ARCH_SS013V100
	help
	  support power control for SS013V100 Cortex-a53

endif

config ARCH_BSP_AMP
	bool "Vendor AMP solution support"
      depends on ARCH_SS318V100 || ARCH_SS918V100 || ARCH_SS812V100 || ARCH_SS813V100 || ARCH_SS312V100 || ARCH_SS313V100 || ARCH_SS011V100 || ARCH_SS012V100 || ARCH_SS013V100
	help
	  support for Vendor AMP solution

config BSP_MC
	bool "Vendor mc platform solution"
	default n
	help
	  support for Vendor mc platform solution

config AMP_ZRELADDR
	hex 'amp zreladdr'
	depends on ARCH_BSP_AMP
	default "0x32008000" if ARCH_SS318V100 || ARCH_SS918V100 || ARCH_SS013V100
	default "0x82008000" if ARCH_SS812V100 || ARCH_SS813V100 || ARCH_SS312V100 || ARCH_SS313V100 || ARCH_SS011V100 || ARCH_SS012V100
	default "0x42008000" if ARCH_SS101V200 || ARCH_SS101V500 || ARCH_SS101V300 || ARCH_SS101V600
config BSP_ZRELADDR
       hex 'zreladdr'
       default "0x40008000" if ARCH_SS524V100
       default "0x40008000" if ARCH_SS615V100
       default "0x40008000" if ARCH_SS522V100
       default "0x40008000" if ARCH_SS522V101
       default "0x80008000" if ARCH_SS812V100
       default "0x80008000" if ARCH_SS813V100
       default "0x80008000" if ARCH_SS312V100
       default "0x80008000" if ARCH_SS313V100
       default "0x80008000" if ARCH_SS011V100
       default "0x80008000" if ARCH_SS012V100
       default "0x80008000" if ARCH_SS612V100
       default "0x40008000" if ARCH_SS101V200 || ARCH_SS101V500 || ARCH_SS101V300 || ARCH_SS101V600
       default "0x22008000" if ARCH_SS318V100 || ARCH_SS918V100 || ARCH_SS013V100

config BSP_PARAMS_PHYS
       hex 'params_phys'
       default "0x00000100"

config BSP_INITRD_PHYS
       hex 'initrd_phys'
       default "0x00800000"

endmenu

endif
```

## drivers/ata/Kconfig.ahci
```kconfig
menuconfig BSP_SATA
	bool "Vendor sata device support"
	depends on (ARCH_SS528V100 || ARCH_SS625V100 || ARCH_SS524V100 || ARCH_SS522V100 || ARCH_SS522V101 || ARCH_SS615V100)
	default n
	select ATA
	select ATA_VERBOSE_ERROR
	select SATA_PMP
	select SATA_AHCI_PLATFORM

if BSP_SATA
config BSP_SATA_IOBASE
	hex "Vendor sata IO address"
	default "0x10390000" if (ARCH_SS528V100 || ARCH_SS625V100)
	default "0x10390000" if (ARCH_SS524V100 || ARCH_SS522V100 || ARCH_SS522V101 || ARCH_SS615V100)
	help
	  vendor sata io base address.

config BSP_SATA_FBS
	int "Vendor sata FIS-Based switching"
	default 1
	range 0 1
	help
	  satav200 supports FBS.
	  FBS is FIS-Based switching.
	  Choose y if you want to use it.

config BSP_SATA_NCQ
	int "Vendor sata Native Command Queuing"
	default 1
	range 0 1
	help
	  satav200 supports NCQ.
	  NCQ is Native Command Queuing.
	  Choose y if you want to use it.

config BSP_ESATA
	bool "Support Vendor eSATA"
	default n
	help
	  satav200 supports eSATA.
	  Choose y if you want to use it.

endif
```

## drivers/clk/vendor/Kconfig
```kconfig
config COMMON_CLK_SS528V100
	tristate "SS528V100 Clock Driver"
	depends on ARCH_SS528V100 || COMPILE_TEST
	select RESET_BSP
	default ARCH_BSP
	help
	  Build the clock driver for SS528V100.

config COMMON_CLK_SS625V100
	tristate "SS625V100 Clock Driver"
	depends on ARCH_SS625V100 || COMPILE_TEST
	select RESET_BSP
	default ARCH_BSP
	help
	  Build the clock driver for SS625V100.

config COMMON_CLK_SS524V100
	tristate "SS524V100 Clock Driver"
	depends on ARCH_SS524V100 || COMPILE_TEST
	select RESET_BSP
	default ARCH_BSP
	help
	  Build the clock driver for SS524V100.

config COMMON_CLK_SS615V100
	tristate "SS615V100 Clock Driver"
	depends on ARCH_SS615V100 || COMPILE_TEST
	select RESET_BSP
	default ARCH_BSP
	help
	  Build the clock driver for SS615V100.

config COMMON_CLK_SS522V100
	tristate "SS522V100 Clock Driver"
	depends on ARCH_SS522V100 || COMPILE_TEST
	select RESET_BSP
	default ARCH_BSP
	help
	  Build the clock driver for SS522V100.

config COMMON_CLK_SS522V101
	tristate "SS522V101 Clock Driver"
	depends on ARCH_SS522V101 || COMPILE_TEST
	select RESET_BSP
	default ARCH_BSP
	help
	  Build the clock driver for SS522V101.
config COMMON_CLK_SS812V100
	tristate "SS812V100 Clock Driver"
	depends on ARCH_SS812V100 || COMPILE_TEST
	select RESET_BSP
	default ARCH_BSP
	help
	  Build the clock driver for SS812V100.

config COMMON_CLK_SS101V200
	tristate "SS101V200 Clock Driver"
	depends on ARCH_SS101V200 || COMPILE_TEST
	select RESET_BSP
	default ARCH_BSP
	help
	  Build the clock driver for SS101V200.

config COMMON_CLK_SS101V500
	tristate "SS101V500 Clock Driver"
	depends on ARCH_SS101V500 || COMPILE_TEST
	select RESET_BSP
	default ARCH_BSP
	help
	  Build the clock driver for SS101V500.

config COMMON_CLK_SS101V300
	tristate "SS101V300 Clock Driver"
	depends on ARCH_SS101V300 || COMPILE_TEST
	select RESET_BSP
	default ARCH_BSP
	help
	  Build the clock driver for SS101V300.

config COMMON_CLK_SS101V600
	tristate "SS101V600 Clock Driver"
	depends on ARCH_SS101V600 || COMPILE_TEST
	select RESET_BSP
	default ARCH_BSP
	help
	  Build the clock driver for SS101V600.

config COMMON_CLK_SS813V100
	tristate "SS813V100 Clock Driver"
	depends on ARCH_SS813V100 || COMPILE_TEST
	select RESET_BSP
	default ARCH_BSP
	help
	  Build the clock driver for SS813V100.

config COMMON_CLK_SS312V100
	tristate "SS312V100 Clock Driver"
	depends on ARCH_SS312V100 || COMPILE_TEST
	select RESET_BSP
	default ARCH_BSP
	help
	  Build the clock driver for SS312V100.

config COMMON_CLK_SS313V100
	tristate "SS313V100 Clock Driver"
	depends on ARCH_SS313V100 || COMPILE_TEST
	select RESET_BSP
	default ARCH_BSP
	help
	  Build the clock driver for SS313V100.

config COMMON_CLK_SS011V100
	tristate "SS011V100 Clock Driver"
	depends on ARCH_SS011V100 || COMPILE_TEST
	select RESET_BSP
	default ARCH_BSP
	help
	  Build the clock driver for SS011V100.

config COMMON_CLK_SS012V100
	tristate "SS012V100 Clock Driver"
	depends on ARCH_SS012V100 || COMPILE_TEST
	select RESET_BSP
	default ARCH_BSP
	help
	  Build the clock driver for SS012V100.

config COMMON_CLK_SS612V100
	tristate "SS612V100 Clock Driver"
	depends on ARCH_SS612V100 || COMPILE_TEST
	select RESET_BSP
	default ARCH_BSP
	help
	  Build the clock driver for SS612V100.

config COMMON_CLK_SS919V100
	tristate "SS919V100 Clock Driver"
	depends on ARCH_SS919V100 || COMPILE_TEST
	select RESET_BSP
	default ARCH_BSP
	help
	  Build the clock driver for ss919v100.

config COMMON_CLK_SS015V100
	tristate "SS015V100 Clock Driver"
	depends on ARCH_SS015V100 || COMPILE_TEST
	select RESET_BSP
	default ARCH_BSP
	help
	  Build the clock driver for ss015v100.

config COMMON_CLK_SS318V100
	tristate "SS318V100 Clock Driver"
	depends on ARCH_SS318V100 || COMPILE_TEST
	select RESET_BSP
	default ARCH_BSP
	help
	  Build the clock driver for ss318v100.

config COMMON_CLK_SS918V100
	tristate "SS918V100 Clock Driver"
	depends on ARCH_SS918V100 || COMPILE_TEST
	select RESET_BSP
	default ARCH_BSP
	help
	  Build the clock driver for ss918v100.

config COMMON_CLK_SS013V100
	tristate "SS013V100 Clock Driver"
	depends on ARCH_SS013V100 || COMPILE_TEST
	select RESET_BSP
	default ARCH_BSP
	help
	  Build the clock driver for ss013v100.

config COMMON_CLK_SS928V100
	tristate "SS928V100 Clock Driver"
	depends on ARCH_SS928V100 || ARCH_SS927V100 || COMPILE_TEST
	select RESET_BSP
	default ARCH_BSP
	help
	  Build the clock driver for ss928v100.
	  
config RESET_BSP
	bool "Vendor Reset Controller Driver"
	depends on ARCH_BSP || COMPILE_TEST || ARCH_BSP
	select RESET_CONTROLLER
	help
	  Build reset controller driver for Vendor device chipsets.
```

## drivers/mmc/host/mci/Kconfig
```kconfig
#
#  mci family SD/MMC device configuration
#
menuconfig MCI
	tristate "mci driver support"
	depends on ARCH_SS812V100 || ARCH_SS813V100 || ARCH_SS312V100 || ARCH_SS313V100 || ARCH_SS011V100 || ARCH_SS012V100
	select MMC_UNSAFE_RESUME
	select MMC_EMBEDDED_SDIO
	select MMC_BLOCK
	select MMC_BLOCK_BOUNCE
	help
	  This selects the Vendor Synopsys MultiMedia Card Driver
	  support. If you want use SD/MMC/SDIO driver,
	  Say Y or M here.

	  default is Y.

config SEND_AUTO_STOP
	bool "Send Auto Stop to terminate data transfer between host and SD card"
	depends on MCI
	default y
```
