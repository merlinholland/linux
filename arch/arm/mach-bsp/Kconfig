## drivers/mtd/spi-nor/Kconfig
```kconfig
menuconfig MTD_SPI_NOR
	tristate "SPI-NOR device support"
	depends on MTD
	help
	  This is the framework for the SPI NOR which can be used by the SPI
	  device drivers and the SPI-NOR device driver.

if MTD_SPI_NOR

config MTD_MT81xx_NOR
	tristate "Mediatek MT81xx SPI NOR flash controller"
	depends on HAS_IOMEM
	help
	  This enables access to SPI NOR flash, using MT81xx SPI NOR flash
	  controller. This controller does not support generic SPI BUS, it only
	  supports SPI NOR Flash.

config MTD_SPI_NOR_USE_4K_SECTORS
	bool "Use small 4096 B erase sectors"
	default y
	help
	  Many flash memories support erasing small (4096 B) sectors. Depending
	  on the usage this feature may provide performance gain in comparison
	  to erasing whole blocks (32/64 KiB).
	  Changing a small part of the flash's contents is usually faster with
	  small sectors. On the other hand erasing should be faster when using
	  64 KiB block instead of 16 × 4 KiB sectors.

	  Please note that some tools/drivers/filesystems may not work with
	  4096 B erase size (e.g. UBIFS requires 15 KiB as a minimum).

config SPI_ASPEED_SMC
	tristate "Aspeed flash controllers in SPI mode"
	depends on ARCH_ASPEED || COMPILE_TEST
	depends on HAS_IOMEM && OF
	help
	  This enables support for the Firmware Memory controller (FMC)
	  in the Aspeed AST2500/AST2400 SoCs when attached to SPI NOR chips,
	  and support for the SPI flash memory controller (SPI) for
	  the host firmware. The implementation only supports SPI NOR.

config SPI_ATMEL_QUADSPI
	tristate "Atmel Quad SPI Controller"
	depends on ARCH_AT91 || (ARM && COMPILE_TEST && !ARCH_EBSA110)
	depends on OF && HAS_IOMEM
	help
	  This enables support for the Quad SPI controller in master mode.
	  This driver does not support generic SPI. The implementation only
	  supports SPI NOR.

config SPI_CADENCE_QUADSPI
	tristate "Cadence Quad SPI controller"
	depends on OF && (ARM || ARM64 || COMPILE_TEST)
	help
	  Enable support for the Cadence Quad SPI Flash controller.

	  Cadence QSPI is a specialized controller for connecting an SPI
	  Flash over 1/2/4-bit wide bus. Enable this option if you have a
	  device with a Cadence QSPI controller and want to access the
	  Flash as an MTD device.

config SPI_FSL_QUADSPI
	tristate "Freescale Quad SPI controller"
	depends on ARCH_MXC || SOC_LS1021A || ARCH_LAYERSCAPE || COMPILE_TEST
	depends on HAS_IOMEM
	help
	  This enables support for the Quad SPI controller in master mode.
	  This controller does not support generic SPI. It only supports
	  SPI NOR.

config SPI_HISI_SFC
	tristate "Hisilicon SPI-NOR Flash Controller(SFC)"
	depends on ARCH_HISI || COMPILE_TEST
	depends on HAS_IOMEM
	help
	  This enables support for hisilicon SPI-NOR flash controller.

config SPI_BSP_SFC
	tristate "Vendor FMCV100 SPI-NOR Flash Controller(SFC)"
	depends on ARCH_BSP || COMPILE_TEST
	depends on HAS_IOMEM && HAS_DMA
	help
	  This enables support for vendor flash memory contrller ver100
	  (FMCV100)- SPI-NOR flash controller.

config SPI_NXP_SPIFI
	tristate "NXP SPI Flash Interface (SPIFI)"
	depends on OF && (ARCH_LPC18XX || COMPILE_TEST)
	depends on HAS_IOMEM
	help
	  Enable support for the NXP LPC SPI Flash Interface controller.

	  SPIFI is a specialized controller for connecting serial SPI
	  Flash. Enable this option if you have a device with a SPIFI
	  controller and want to access the Flash as a mtd device.

config SPI_INTEL_SPI
	tristate

config SPI_INTEL_SPI_PCI
	tristate "Intel PCH/PCU SPI flash PCI driver (DANGEROUS)"
	depends on X86 && PCI
	select SPI_INTEL_SPI
	help
	  This enables PCI support for the Intel PCH/PCU SPI controller in
	  master mode. This controller is present in modern Intel hardware
	  and is used to hold BIOS and other persistent settings. Using
	  this driver it is possible to upgrade BIOS directly from Linux.

	  Say N here unless you know what you are doing. Overwriting the
	  SPI flash may render the system unbootable.

	  To compile this driver as a module, choose M here: the module
	  will be called intel-spi-pci.

config SPI_INTEL_SPI_PLATFORM
	tristate "Intel PCH/PCU SPI flash platform driver (DANGEROUS)"
	depends on X86
	select SPI_INTEL_SPI
	help
	  This enables platform support for the Intel PCH/PCU SPI
	  controller in master mode. This controller is present in modern
	  Intel hardware and is used to hold BIOS and other persistent
	  settings. Using this driver it is possible to upgrade BIOS
	  directly from Linux.

	  Say N here unless you know what you are doing. Overwriting the
	  SPI flash may render the system unbootable.

	  To compile this driver as a module, choose M here: the module
	  will be called intel-spi-platform.

config SPI_STM32_QUADSPI
	tristate "STM32 Quad SPI controller"
	depends on ARCH_STM32 || COMPILE_TEST
	help
	  This enables support for the STM32 Quad SPI controller.
	  We only connect the NOR to this controller.

config MTD_SPI_IDS
    bool "SPI Flash Timing Cycles Probe Function"
    default n
    help
      This option enables sfc300/sfc350 used spi flash timing cylces
      probe function.
      If your use sfc300 and sfc350, this function should be select.

config CLOSE_SPI_8PIN_4IO
	bool "Close SPI device Quad SPI mode for some 8PIN chip"
	default y if ARCH_BSP
	help
	fmcv100 and sfcv350 support Quad SPI mode and Quad&addr SPI mode.
	But some 8PIN chip does not support this mode when HOLD/IO3 PIN
	was used by reset operation.
	Usually, your should not config this option.

config BSP_SPI_BLOCK_PROTECT
	bool "Vendor Spi Nor Device BP(Block Protect) Support"
	depends on SPI_BSP_SFC
	default y if SPI_BSP_SFC
	help
	  SFC supports BP(Block Protect) feature to preestablish a series
	  area to avoid writing and erasing, except to reading. With this macro
	  definition we can get the BP info which was setted before. The
	  BOTTOM/TOP bit is setted to BOTTOM, it means the lock area starts
	  from 0 address.
	  
endif # MTD_SPI_NOR
```

## drivers/pci/bsp_pcie/Kconfig
```kconfig
menuconfig BSP_PCIE
	bool "Vendor PCI Express support"
	depends on PCI && (ARCH_SS528V100 || ARCH_SS625V100 || ARCH_SS919V100 || ARCH_SS918V100 || ARCH_SS013V100 || ARCH_SS015V100 || ARCH_SS928V100 || ARCH_SS927V100)
	default y if PCI
	default n if ! PCI
	help
	 Vendor PCI Express support
	 Choose this selection to support PCI Express uses.

if BSP_PCIE

menu "PCI Express configs"


config LIMIT_MAX_RD_REQ_SIZE
	bool "limit pcie max read request size"
	depends on PCI && (ARCH_SS528V100 || ARCH_SS625V100 || ARCH_SS919V100 || ARCH_SS918V100 || ARCH_SS013V100 || ARCH_SS015V100 || ARCH_SS928V100 || ARCH_SS927V100)
	help
	 The default max read request size of pcie device is 512 Byte. When pcie use
	 the card of pcie-to-sata to connect to the sata disk, with the default max read
	 request size value of 512 byte, would cause the low bandwidth of VDP. If you enable
	 the LIMIT_MAX_RD_REQ_SIZE config, the max read request size of pcie device would be
	 set to 128 byte, and the problem of VDP low band width also be avoided.

endmenu

endif
```

## drivers/phy/vendor/Kconfig
```kconfig
config PHY_BSP_SATA
	tristate "Vendor sata phy support"
	depends on (ARCH_SS528V100 || ARCH_SS625V100 || ARCH_SS524V100 || ARCH_SS522V100 || ARCH_SS522V101 || ARCH_SS615V100) && OF && HAS_IOMEM
	default n
	select GENERIC_PHY
	help
	  Enable this to support the sata phy that is part of
	  sata driver for Vendor

config BSP_SATA_MODE
	int "Vendor sata interworking speed mode(1.5G:0/3G:1/6G:2)"
	depends on PHY_BSP_SATA
	help
	  Vendor sata interworking speed mode

menuconfig VENDOR_USB_PHY
	tristate "Vendor USB support"

if VENDOR_USB_PHY

source "drivers/phy/vendor/usb/Kconfig"

endif # VENDOR_USB_PHY
```

## drivers/phy/vendor/usb/Kconfig
```kconfig
#
# Phy drivers for Vendor platforms
#
config PHY_BSP_USB2
	bool
	depends on (!ARCH_SS919V100 && !ARCH_SS015V100 && !ARCH_SS101V200 && \
		!ARCH_SS101V500 && !ARCH_SS101V300 && !ARCH_SS101V600 && \
		!ARCH_SS928V100 && !ARCH_SS927V100)
	default y
	help
	  Support for PHY on Vendor Socs. This Phy supports
	  USB 1.5Mb/s, USB 12Mb/s, USB 480Mb/s speeds. It suppots one
	  USB host port to accept one USB device. Support init the phy
	  and adjust phy Eye Diagram.

config PHY_BSP_USB3
	bool
	depends on (ARCH_SS918V100 || ARCH_SS318V100 || ARCH_SS919V100 || \
		ARCH_SS015V100 || ARCH_SS013V100 || ARCH_SS528V100 || \
		ARCH_SS625V100 || ARCH_SS928V100 || ARCH_SS927V100)
	default y
	help
	  Support for PHY on Vendor Socs. This Phy supports
	  USB3.0 and Compatible with USB2.0. It suppots one
	  USB host port to accept one USB device. Support init the phy
	  and adjust phy Eye Diagram.

config BSP_USB_PHY
	bool "Vendor USB PHY driver"
	depends on (!ARCH_SS101V200 && !ARCH_SS101V500 && !ARCH_SS101V300 && \
		!ARCH_SS101V600)
	default y
	help
	  Support for PHY on Vendor Socs. This Phy supports
	  USB 1.5Mb/s, USB 12Mb/s, USB 480Mb/s speeds. It suppots one
	  USB host port to accept one USB device. Support init the phy
	  and adjust phy Eye Diagram.

config PHY_BSP_XVP_USB2
	tristate "Vendor XVP USB2 PHY Driver"
	depends on (ARCH_SS101V200 || ARCH_SS101V500 || ARCH_SS101V300 || \
		ARCH_SS101V600)
	select GENERIC_PHY
	default y
	help
	  Support for PHY on Vendor Socs. This Phy supports
	  USB 1.5Mb/s, USB 12Mb/s, USB 480Mb/s speeds. It suppots one
	  USB host port to accept one USB device. Support init the phy
	  and adjust phy Eye Diagram.

menuconfig USB_MODE_OPTION
	bool "Vendor USB related configuration"
	depends on (!ARCH_SS101V200 && !ARCH_SS101V500 && !ARCH_SS101V300 && \
		!ARCH_SS101V600 && !ARCH_SS528V100 && !ARCH_SS625V100 &&	\
		!ARCH_SS524V100 && !ARCH_SS522V100 && !ARCH_SS615V100 &&    \
		!ARCH_SS522V101)

if USB_MODE_OPTION

config USB_DRD0_IN_HOST
	bool "USB DRD0 Mode Select HOST"
	help
	  Select whether the USB drd0 is working in host mode.

config USB_DRD0_IN_DEVICE
	bool "USB DRD0 Mode Select DEVICE"
	depends on !USB_DRD0_IN_HOST
	depends on (!ARCH_SS528V100 && !ARCH_SS625V100 && !ARCH_SS524V100 && \
		!ARCH_SS522V100 && !ARCH_SS615V100 && !ARCH_SS522V101)
	help
	  Select whether the USB drd0 is working in device mode.

config USB_DRD1_IN_HOST
	bool "USB DRD1 Mode Select HOST"
	depends on (ARCH_SS918V100 || ARCH_SS318V100 || ARCH_SS919V100 ||	\
		ARCH_SS015V100 || ARCH_SS013V100)
	help
	  Select whether the USB drd1 is working in host mode.

config USB_DRD1_IN_DEVICE
	bool "USB DRD1 Mode Select DEVICE"
	depends on (!USB_DRD1_IN_HOST && !USB_DRD0_IN_DEVICE)
	depends on (ARCH_SS918V100 || ARCH_SS318V100 || ARCH_SS919V100 || \
		ARCH_SS015V100 || ARCH_SS013V100)
	help
	  Select whether the USB drd1 is working in device mode.

endif # USB_MODE_OPTION
```

## drivers/vendor/Kconfig
```kconfig
menu "Vendor driver support"

source "drivers/vendor/cma/Kconfig"
source "drivers/vendor/npu/Kconfig"
endmenu
```
